-carm
-Z(CODE)START,CODE,SWITAB,INITTAB,DATA_ID,DATA_C,CONFIG_DATA_ID=A1324000-A1346050 //A0078000-A009A050

// <config>
// Autogenerated with tools/porting.js

// 20k unused memory block
-Z(DATA)DATA_Z,DATA_I,DATA_N=A8F6A500-A8F6F500

// BL to any void-function in low level OS initialization (after ExtRAM init)
-Z(CODE)PATCH_LL_INIT_HOOK=A05425DC-A05425DF

// Fix IDLE CSM restart on SIM error
-Z(CODE)PATCH_NO_IDLE_RESTART=A05BFB94-A05BFBA7

// Fix race condition in BSD sockets
-Z(CODE)PATCH_SOCKET_FUNC_SOCKET=A0A594C4-A0A594E3
-Z(CODE)PATCH_SOCKET_FUNC_BIND=A0A597E0-A0A597FF
-Z(CODE)PATCH_SOCKET_FUNC_CONNECT=A0A599E8-A0A59A07
-Z(CODE)PATCH_SOCKET_FUNC_SHUTDOWN=A0A59B82-A0A59BA1
-Z(CODE)PATCH_SOCKET_FUNC_RECV=A0A59DA8-A0A59DC7
-Z(CODE)PATCH_SOCKET_FUNC_RECV2=A0A59E34-A0A59E53
-Z(CODE)PATCH_SOCKET_FUNC_SENDTO=A0A5A5A8-A0A5A5C7
-Z(CODE)PATCH_SOCKET_FUNC_LISTEN=A0A5A722-A0A5A741
-Z(CODE)PATCH_SOCKET_FUNC_RECVFROM=A0A59FEE-A0A5A00D
-Z(CODE)PATCH_SOCKET_FUNC_RECVFROM2=A0A5A086-A0A5A0A5
-Z(CODE)PATCH_SOCKET_FUNC_SEND=A0A5A29E-A0A5A2BD
-Z(CODE)PATCH_SOCKET_FUNC_SEND2=A0A5A366-A0A5A385
-Z(CODE)PATCH_SOCKET_FUNC_GETHOSTBYNAME=A0A5AC94-A0A5ACB3
// </config>

//A0074000
-Z(CODE)PATCH_ONCREATE=A084B698-A084B69B
-Z(CODE)PATCH_ONCLOSE=A084B6AC-A084B6AF

-Z(CODE)PATCH_ESI1=A08D5FF4-A08D5FF7
-Z(CODE)PATCH_ESI2=A08D6004-A08D6007

-Z(CODE)PATCH_SHOWMSG_BLF=A07F9600-A07F9603
-Z(CODE)PATCH_NO_BROWSE_TXT=A06C697A-A06C697D

-Z(CODE)SWILIB_FUNC171=A00745C4-A00745C7
-Z(CODE)SWILIB_FUNC172=A00745C8-A00745CB
-Z(CODE)SWILIB_FUNC19C=A0074670-A0074673
-Z(CODE)SWILIB_FUNC1B8_1BB=A00746E0-A00746EF
-Z(CODE)SWILIB_FUNC1E9=A00747A4-A00747A7
-Z(CODE)SWILIB_FUNC2EE=A0074BB8-A0074C0C

-Z(DATA)REGEXPL_CNT=A8D9F174-A8D9F177

-Z(CODE)PATCH_EXT2_R7=A0502A78-A0502A7B
-Z(CODE)PATCH_EXT2_R6=A0502C5C-A0502C5F
-Z(CODE)PATCH_EXT2_R7_1=A05026AC-A05026AF
-Z(CODE)PATCH_EXT2_R2=A0502830-A0502833

-Z(CODE)PATCH_EXT2_IMPL=A0502AFC-A0502B1F

-Z(CODE)PATCH_ENABLE_ALTOPEN=A071CDD4-A071CDD7

-Z(CODE)PATCH_GET_PIT=A094CE9A-A094CE9D
-Z(CODE)PATCH_GET_PITJ=A094CEA0-A094CEA3

-Z(CODE)FSWI_PATCH1=A12D1414-A12D1417  //000002A4+A13A10D0
-Z(CODE)FSWI_PATCH2=A12D1328-A12D132B  //000001B8+A13A10D0
-Z(CODE)LIBR=A0074000-A0077FFF
