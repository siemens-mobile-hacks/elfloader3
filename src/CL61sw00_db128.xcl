//CL61v00 db128 (p)Evgr, (f)Marie

-carm
-Z(CODE)START,CODE,SWITAB,INITTAB,DATA_ID,DATA_C,CONFIG_DATA_ID=A1324000-A1329000

// <config>
// Autogenerated with tools/porting.js

// 20k unused memory block
-Z(DATA)DATA_Z,DATA_I,DATA_N=A8F34C00-A8F39C00

// BL to any void-function in low level OS initialization (after ExtRAM init)
-Z(CODE)PATCH_LL_INIT_HOOK=A0431694-A0431697

// Fix IDLE CSM restart on SIM error
-Z(CODE)PATCH_NO_IDLE_RESTART=A00FA390-A00FA3A3

// Fix race condition in BSD sockets
-Z(CODE)PATCH_SOCKET_FUNC_SOCKET=A0B6C444-A0B6C463
-Z(CODE)PATCH_SOCKET_FUNC_BIND=A0B6C760-A0B6C77F
-Z(CODE)PATCH_SOCKET_FUNC_CONNECT=A0B6C968-A0B6C987
-Z(CODE)PATCH_SOCKET_FUNC_SHUTDOWN=A0B6CB02-A0B6CB21
-Z(CODE)PATCH_SOCKET_FUNC_RECV=A0B6CD28-A0B6CD47
-Z(CODE)PATCH_SOCKET_FUNC_RECV2=A0B6CDB4-A0B6CDD3
-Z(CODE)PATCH_SOCKET_FUNC_SENDTO=A0B6D528-A0B6D547
-Z(CODE)PATCH_SOCKET_FUNC_LISTEN=A0B6D6A2-A0B6D6C1
-Z(CODE)PATCH_SOCKET_FUNC_RECVFROM=A0B6CF6E-A0B6CF8D
-Z(CODE)PATCH_SOCKET_FUNC_RECVFROM2=A0B6D006-A0B6D025
-Z(CODE)PATCH_SOCKET_FUNC_SEND=A0B6D21E-A0B6D23D
-Z(CODE)PATCH_SOCKET_FUNC_SEND2=A0B6D2E6-A0B6D305
-Z(CODE)PATCH_SOCKET_FUNC_GETHOSTBYNAME=A0B6DC14-A0B6DC33
// </config>
                                                                                                                                                                            
-Z(CODE)PATCH_ONCREATE=A0E4828C-FFFFFFFF
-Z(CODE)PATCH_ONCLOSE=A0E482A0-FFFFFFFF 
                                                                                                                                                                      

-Z(CODE)PATCH_ESI1=A075B260-FFFFFFFF
-Z(CODE)PATCH_ESI2=A075B270-FFFFFFFF

-Z(CODE)PATCH_SHOWMSG_BLF=A0A35598-FFFFFFFF
-Z(CODE)PATCH_NO_BROWSE_TXT=A016E106-FFFFFFFF

-Z(CODE)SWILIB_FUNC171=A13205C4-A13205C7
-Z(CODE)SWILIB_FUNC172=A13205C8-A13205CB
-Z(CODE)SWILIB_FUNC19C=A1320670-A1320673
-Z(CODE)SWILIB_FUNC1B8_1BB=A13206E0-A13206EF
-Z(CODE)SWILIB_FUNC1E9=A13207A4-A13207A7
-Z(CODE)SWILIB_FUNC2EE=A1320BB8-A1320C0C

-Z(DATA)REGEXPL_CNT=A8D9DD50-A8D9DD53

-Z(CODE)PATCH_EXT2_R7=A074721C-FFFFFFFF
-Z(CODE)PATCH_EXT2_R6=A0747400-FFFFFFFF
-Z(CODE)PATCH_EXT2_R7_1=A0746E50-FFFFFFFF
-Z(CODE)PATCH_EXT2_R2=A0746FD4-FFFFFFFF

-Z(CODE)PATCH_EXT2_IMPL=A07472A0-FFFFFFFF

-Z(CODE)PATCH_ENABLE_ALTOPEN=A053D4E4-FFFFFFFF

-Z(CODE)PATCH_GET_PIT=A047E7FE-FFFFFFFF
-Z(CODE)PATCH_GET_PITJ=A047E804-FFFFFFFF

-Z(CODE)FSWI_PATCH1=A12FF8C8-FFFFFFFF
-Z(CODE)FSWI_PATCH2=A12FF7DC-FFFFFFFF
-Z(CODE)LIBR=A1320000-A1323FFF
