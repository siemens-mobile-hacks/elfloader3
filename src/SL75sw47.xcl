-carm
// SL75v47!!!

-Z(CODE)START,CODE,SWITAB,INITTAB,DATA_ID,DATA_C,CONFIG_DATA_ID=A0078000-A007D000

// <config>
// Autogenerated with tools/src/porting.ts

// 20k unused memory block
-Z(DATA)DATA_Z,DATA_I,DATA_N=A8EA0C00-A8EA5C00

// BL to any void-function in low level OS initialization (after ExtRAM init)
-Z(CODE)PATCH_LL_INIT_HOOK=A02330CC-A02330CF

// Fix IDLE CSM restart on SIM error
-Z(CODE)PATCH_NO_IDLE_RESTART=A029BD06-A029BD1D

// Fix race condition in BSD sockets
-Z(CODE)PATCH_SOCKET_FUNC_SOCKET=A0A4CC50-A0A4CC6F
-Z(CODE)PATCH_SOCKET_FUNC_BIND=A0A4CF6C-A0A4CF8B
-Z(CODE)PATCH_SOCKET_FUNC_CONNECT=A0A4D174-A0A4D193
-Z(CODE)PATCH_SOCKET_FUNC_SHUTDOWN=A0A4D30E-A0A4D32D
-Z(CODE)PATCH_SOCKET_FUNC_RECV=A0A4D534-A0A4D553
-Z(CODE)PATCH_SOCKET_FUNC_RECV2=A0A4D5C0-A0A4D5DF
-Z(CODE)PATCH_SOCKET_FUNC_SENDTO=A0A4DD34-A0A4DD53
-Z(CODE)PATCH_SOCKET_FUNC_LISTEN=A0A4DEAE-A0A4DECD
-Z(CODE)PATCH_SOCKET_FUNC_RECVFROM=A0A4D77A-A0A4D799
-Z(CODE)PATCH_SOCKET_FUNC_RECVFROM2=A0A4D812-A0A4D831
-Z(CODE)PATCH_SOCKET_FUNC_SEND=A0A4DA2A-A0A4DA49
-Z(CODE)PATCH_SOCKET_FUNC_SEND2=A0A4DAF2-A0A4DB11
-Z(CODE)PATCH_SOCKET_FUNC_GETHOSTBYNAME=A0A4E420-A0A4E43F

// SWILIB
-Z(CODE)LIBR=A0074000-A0077FFF
-Z(CODE)SWILIB_FUNC00B=A007402C-A007402F
-Z(CODE)SWILIB_FUNC00C=A0074030-A0074033
-Z(CODE)SWILIB_FUNC095=A0074254-A0074257
-Z(CODE)SWILIB_FUNC12B_12D=A00744AC-A00744B7
-Z(CODE)SWILIB_FUNC171=A00745C4-A00745C7
-Z(CODE)SWILIB_FUNC172=A00745C8-A00745CB
-Z(CODE)SWILIB_FUNC19C=A0074670-A0074673
-Z(CODE)SWILIB_FUNC1B8_1BB=A00746E0-A00746EF
-Z(CODE)SWILIB_FUNC1E9=A00747A4-A00747A7
-Z(CODE)SWILIB_FUNC2EE=A0074BB8-A0074BFF
// </config>

//A0074000
-Z(CODE)PATCH_ONCREATE=A04324A0-A04324A3
-Z(CODE)PATCH_ONCLOSE=A04324B4-A04324B7
-Z(CODE)PATCH_ESI1=A0908218-A090821B
-Z(CODE)PATCH_ESI2=A0908228-A090822B
-Z(CODE)PATCH_SHOWMSG_BLF=A0660734-A0660737
-Z(CODE)PATCH_NO_BROWSE_TXT=A055273A-A055273F

-Z(CODE)PATCH_EXT2_R4R7=A04D996A-A04D996F     // +
-Z(CODE)PATCH_EXT2_R6R5=A04D9a84-A04D9a87     // +
-Z(CODE)PATCH_EXT2_R5R1=A04D97d2-A04D97d5     // +
-Z(CODE)PATCH_EXT2_R5R7=A04D96d4-A04D96d7     // +
-Z(CODE)PATCH_EXT2_CLUST1=A04D9996-A04D9997   // +
-Z(CODE)PATCH_EXT2_CLUST2=A04D96f4-A04D96f5   // +
-Z(CODE)PATCH_EXT2_JUMPERS=A04d3808-A04D382F  // +
-Z(CODE)PATCH_EXT2_IMPL=A04D99b4-A04D99c9    //+


-Z(CODE)PATCH_ENABLE_ALTOPEN=A05A2E56-A05A2E57

-Z(CODE)PATCH_GET_PIT=A09780a4-A09780a7       // +
-Z(CODE)PATCH_GET_PITJ=A09780a8-A09780aB      // +

-Z(CODE)FSWI_PATCH1=A13A2ADC-A13A2ADF
-Z(CODE)FSWI_PATCH2=A13A29F0-A13A29F3
