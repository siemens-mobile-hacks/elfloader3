-carm
-Z(CODE)START,CODE,SWITAB,INITTAB,DATA_ID,DATA_C,CONFIG_DATA_ID=A0078000-A007D000

// <config>
// Autogenerated with tools/porting.js

// 20k unused memory block
-Z(DATA)DATA_Z,DATA_I,DATA_N=A8EA0C00-A8EA5C00

// BL to any void-function in low level OS initialization (after ExtRAM init)
-Z(CODE)PATCH_LL_INIT_HOOK=A02313E8-A02313EB

// Fix IDLE CSM restart on SIM error
-Z(CODE)PATCH_NO_IDLE_RESTART=A0299D06-A0299D1D

// Fix race condition in BSD sockets
-Z(CODE)PATCH_SOCKET_FUNC_SOCKET=A0A492F0-A0A4930F
-Z(CODE)PATCH_SOCKET_FUNC_BIND=A0A4960C-A0A4962B
-Z(CODE)PATCH_SOCKET_FUNC_CONNECT=A0A49814-A0A49833
-Z(CODE)PATCH_SOCKET_FUNC_SHUTDOWN=A0A499AE-A0A499CD
-Z(CODE)PATCH_SOCKET_FUNC_RECV=A0A49BD4-A0A49BF3
-Z(CODE)PATCH_SOCKET_FUNC_RECV2=A0A49C60-A0A49C7F
-Z(CODE)PATCH_SOCKET_FUNC_SENDTO=A0A4A3D4-A0A4A3F3
-Z(CODE)PATCH_SOCKET_FUNC_LISTEN=A0A4A54E-A0A4A56D
-Z(CODE)PATCH_SOCKET_FUNC_RECVFROM=A0A49E1A-A0A49E39
-Z(CODE)PATCH_SOCKET_FUNC_RECVFROM2=A0A49EB2-A0A49ED1
-Z(CODE)PATCH_SOCKET_FUNC_SEND=A0A4A0CA-A0A4A0E9
-Z(CODE)PATCH_SOCKET_FUNC_SEND2=A0A4A192-A0A4A1B1
-Z(CODE)PATCH_SOCKET_FUNC_GETHOSTBYNAME=A0A4AAC0-A0A4AADF
// </config>

//A0074000

-Z(CODE)PATCH_ONCREATE=A042E748-A042E74B
-Z(CODE)PATCH_ONCLOSE=A042E75C-A042E75F
-Z(CODE)PATCH_ESI1=A0902B54-A0902B57
-Z(CODE)PATCH_ESI2=A0902B64-A0902B67
-Z(CODE)PATCH_SHOWMSG_BLF=A065AB30-A065AB33
-Z(CODE)PATCH_NO_BROWSE_TXT=A05464C6-A05464C7

-Z(CODE)SWILIB_FUNC171=A00745C4-A00745C7
-Z(CODE)SWILIB_FUNC172=A00745C8-A00745CB
-Z(CODE)SWILIB_FUNC19C=A0074670-A0074673
-Z(CODE)SWILIB_FUNC1B8_1BB=A00746E0-A00746EF
-Z(CODE)SWILIB_FUNC1E9=A00747A4-A00747A7
-Z(CODE)SWILIB_FUNC2EE=A0074BB8-A0074C0C

-Z(CODE)PATCH_EXT2_R4R7=A04D486E-A04D4871
-Z(CODE)PATCH_EXT2_R6R5=A04D4988-A04D498B
-Z(CODE)PATCH_EXT2_R5R1=A04D46D6-A04D46D9
-Z(CODE)PATCH_EXT2_R5R7=A04D45D8-A04D45DB
-Z(CODE)PATCH_EXT2_CLUST1=A04D489A-A04D489B
-Z(CODE)PATCH_EXT2_CLUST2=A04D45F8-A04D45F9
-Z(CODE)PATCH_EXT2_JUMPERS=A04CF1E0-A04CF207
-Z(CODE)PATCH_EXT2_IMPL=A04D48B8-A04D48CD

-Z(CODE)PATCH_ENABLE_ALTOPEN=A0599912-A0599913

-Z(CODE)PATCH_GET_PIT=A0975D34-A0975D37
-Z(CODE)PATCH_GET_PITJ=A0975D38-A0975D3B

-Z(CODE)FSWI_PATCH1=A13A1374-A13A1377	//000002A4+A13A10D0
-Z(CODE)FSWI_PATCH2=A13A1288-A13A128B	//000001B8+A13A10D0
-Z(CODE)LIBR=A0074000-A0077FFF
