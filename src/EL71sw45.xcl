//EL71v45

-carm
-Z(CODE)START,CODE,SWITAB,INITTAB,DATA_ID,DATA_C,CONFIG_DATA_ID=A0078000-A007D000

//A0074000

// <config>
// Autogenerated with tools/porting.js

// 20k unused memory block
-Z(DATA)DATA_Z,DATA_I,DATA_N=A8F69F00-A8F6EF00

// BL to any void-function in low level OS initialization (after ExtRAM init)
-Z(CODE)PATCH_LL_INIT_HOOK=A0548824-A0548827

// Fix IDLE CSM restart on SIM error
-Z(CODE)PATCH_NO_IDLE_RESTART=A05C11C0-A05C11D3

// Fix race condition in BSD sockets
-Z(CODE)PATCH_SOCKET_FUNC_SOCKET=A0A63270-A0A6328F
-Z(CODE)PATCH_SOCKET_FUNC_BIND=A0A6358C-A0A635AB
-Z(CODE)PATCH_SOCKET_FUNC_CONNECT=A0A63794-A0A637B3
-Z(CODE)PATCH_SOCKET_FUNC_SHUTDOWN=A0A6392E-A0A6394D
-Z(CODE)PATCH_SOCKET_FUNC_RECV=A0A63B54-A0A63B73
-Z(CODE)PATCH_SOCKET_FUNC_RECV2=A0A63BE0-A0A63BFF
-Z(CODE)PATCH_SOCKET_FUNC_SENDTO=A0A64354-A0A64373
-Z(CODE)PATCH_SOCKET_FUNC_LISTEN=A0A644CE-A0A644ED
-Z(CODE)PATCH_SOCKET_FUNC_RECVFROM=A0A63D9A-A0A63DB9
-Z(CODE)PATCH_SOCKET_FUNC_RECVFROM2=A0A63E32-A0A63E51
-Z(CODE)PATCH_SOCKET_FUNC_SEND=A0A6404A-A0A64069
-Z(CODE)PATCH_SOCKET_FUNC_SEND2=A0A64112-A0A64131
-Z(CODE)PATCH_SOCKET_FUNC_GETHOSTBYNAME=A0A64A40-A0A64A5F
// </config>


-Z(CODE)PATCH_ONCREATE=A0853F98-A0853F9B
-Z(CODE)PATCH_ONCLOSE=A0853FAC-A0853FAF


-Z(CODE)PATCH_ESI1=A08DF41C-A08DF41F
-Z(CODE)PATCH_ESI2=A08DF42C-A08DF42F

-Z(CODE)PATCH_SHOWMSG_BLF=A07FF180-A07FF184
-Z(CODE)PATCH_NO_BROWSE_TXT=A06Cc03A-A06Cc03B

-Z(CODE)SWILIB_FUNC171=A00745C4-A00745C7
-Z(CODE)SWILIB_FUNC172=A00745C8-A00745CB
-Z(CODE)SWILIB_FUNC19C=A0074670-A0074673
-Z(CODE)SWILIB_FUNC1B8_1BB=A00746E0-A00746EF
-Z(CODE)SWILIB_FUNC1E9=A00747A4-A00747A7
-Z(CODE)SWILIB_FUNC2EE=A0074BB8-A0074C0C

-Z(DATA)REGEXPL_CNT=A8D9F000-A8D9F003

-Z(CODE)PATCH_EXT2_R7=A0508220-A0508223
-Z(CODE)PATCH_EXT2_R6=A0508404-A0508407
-Z(CODE)PATCH_EXT2_R7_1=A0507E54-A0507E57
-Z(CODE)PATCH_EXT2_R2=A0507FD8-A0507FDB

-Z(CODE)PATCH_EXT2_IMPL=A05082A4-A05082C7

-Z(CODE)PATCH_ENABLE_ALTOPEN=A072A414-A072A417

-Z(CODE)PATCH_GET_PIT=A0956C1E-A0956C21
-Z(CODE)PATCH_GET_PITJ=A0956C24-A0956C27

-Z(CODE)FSWI_PATCH1=A12DD85C-A12DD85F	//000002A4+A13A10D0
-Z(CODE)FSWI_PATCH2=A12DD770-A12DD773	//000001B8+A13A10D0
-Z(CODE)LIBR=A0074000-A0077FFF
