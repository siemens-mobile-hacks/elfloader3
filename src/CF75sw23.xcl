// (p)Dimadze

-carm
-Z(CODE)START,CODE,SWITAB,INITTAB,DATA_ID,DATA_C,CONFIG_DATA_ID=A10E8000-A10ED000 // ELFLOADER BODY PLACE Addr: 0xA10E8000, Len: 0x5000 (20 ��)

-Z(DATA)CONFIG_DATA_I,DATA_Z,DATA_N=A84BE928-A84BF128 // RAM OF ELFLOADER = RAM OF EXT COUNT + 0x04 Len: 0x800 (2 ��) 

// <config>
// Autogenerated with tools/src/porting.ts

// SWILIB
-Z(CODE)LIBR=A10E4000-A10E7FFF
-Z(CODE)SWILIB_FUNC00B=A10E402C-A10E402F
-Z(CODE)SWILIB_FUNC00C=A10E4030-A10E4033
-Z(CODE)SWILIB_FUNC095=A10E4254-A10E4257
-Z(CODE)SWILIB_FUNC12B_12D=A10E44AC-A10E44B7
-Z(CODE)SWILIB_FUNC171=A10E45C4-A10E45C7
-Z(CODE)SWILIB_FUNC172=A10E45C8-A10E45CB
-Z(CODE)SWILIB_FUNC19C=A10E4670-A10E4673
-Z(CODE)SWILIB_FUNC1B8_1BB=A10E46E0-A10E46EF
-Z(CODE)SWILIB_FUNC1E9=A10E47A4-A10E47A7
-Z(CODE)SWILIB_FUNC2EE=A10E4BB8-A10E4BFF
// </config>

//A10E4000
-Z(CODE)PATCH_ONCREATE=A0495B70-A0495B73
-Z(CODE)PATCH_ONCLOSE=A0495B74-A0495B77    //PATCH_ONCREATE + 0X04
-Z(CODE)PATCH_ESI=A0A1CE58-A0A1CE5F

-Z(CODE)PATCH_NO_UNK_EXT=A02A0894-A02A0897

-Z(DATA)REGEXPL_CNT=A84BE924-A84BE927         //RAM OF EXT COUNT
-Z(CODE)REG_FILE=A02A0E8C-FFFFFFFF

-Z(CODE)PATCH_GET_EXT=A02A0864-A02A0867
-Z(CODE)PATCH_GET_REGEXT1=A02A0674-A02A0677
-Z(CODE)PATCH_GET_REGEXT2=A02A0688-A02A068B
-Z(CODE)PATCH_BIG_ICON=A0356290-A0356293
-Z(CODE)PATCH_REGEXPL=A02A0F74-A02A0F77

-Z(CODE)PATCH_GET_PIT=A07B8638-A07B863B
-Z(CODE)PATCH_GET_PITJ=A07B863C-A07B863F      // PATCH_GET_PIT  + 0x04

-Z(CODE)PATCH_KEYB_MSG=A07AD54C-A07AD54F
-Z(CODE)PATCH_KEYB_MSGJ=A07AD550-A07AD553     //PATCH_KEYB_MSG + 0x04

-Z(CODE)FSWI_PATCH1=A00929B4-A00929B7         
-Z(CODE)FSWI_PATCH2=A0092A98-A0092A9B         //FSWI_PATCH1 + 0xE4
-Z(CODE)FSWI_PATCH3=A0092A97-A0092A98         //FSWI_PATCH2 - 0x01
