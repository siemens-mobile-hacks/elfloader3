-carm
// SL75v52!!!  (p) kiREALlov

-Z(CODE)START,CODE,SWITAB,INITTAB,DATA_ID,DATA_C,CONFIG_DATA_ID=A0078000-A007D000

// <config>
// Autogenerated with tools/src/porting.ts

// 20k unused memory block
-Z(DATA)DATA_Z,DATA_I,DATA_N=A8EA0C00-A8EA5C00

// BL to any void-function in low level OS initialization (after ExtRAM init)
-Z(CODE)PATCH_LL_INIT_HOOK=A0233278-A023327B

// Fix IDLE CSM restart on SIM error
-Z(CODE)PATCH_NO_IDLE_RESTART=A029BEEE-A029BF05

// Fix race condition in BSD sockets
-Z(CODE)PATCH_SOCKET_FUNC_SOCKET=A0A4D868-A0A4D887
-Z(CODE)PATCH_SOCKET_FUNC_BIND=A0A4DB84-A0A4DBA3
-Z(CODE)PATCH_SOCKET_FUNC_CONNECT=A0A4DD8C-A0A4DDAB
-Z(CODE)PATCH_SOCKET_FUNC_SHUTDOWN=A0A4DF26-A0A4DF45
-Z(CODE)PATCH_SOCKET_FUNC_RECV=A0A4E14C-A0A4E16B
-Z(CODE)PATCH_SOCKET_FUNC_RECV2=A0A4E1D8-A0A4E1F7
-Z(CODE)PATCH_SOCKET_FUNC_SENDTO=A0A4E94C-A0A4E96B
-Z(CODE)PATCH_SOCKET_FUNC_LISTEN=A0A4EAC6-A0A4EAE5
-Z(CODE)PATCH_SOCKET_FUNC_RECVFROM=A0A4E392-A0A4E3B1
-Z(CODE)PATCH_SOCKET_FUNC_RECVFROM2=A0A4E42A-A0A4E449
-Z(CODE)PATCH_SOCKET_FUNC_SEND=A0A4E642-A0A4E661
-Z(CODE)PATCH_SOCKET_FUNC_SEND2=A0A4E70A-A0A4E729
-Z(CODE)PATCH_SOCKET_FUNC_GETHOSTBYNAME=A0A4F038-A0A4F057

// SWILIB
-Z(CODE)LIBR=A0074000-A0077FFF
-Z(CODE)SWILIB_FUNC00B=A007402C-A007402F
-Z(CODE)SWILIB_FUNC00C=A0074030-A0074033
-Z(CODE)SWILIB_FUNC095=A0074254-A0074257
-Z(CODE)SWILIB_FUNC12B_12D=A00744AC-A00744B7
-Z(CODE)SWILIB_FUNC171=A00745C4-A00745C7
-Z(CODE)SWILIB_FUNC172=A00745C8-A00745CB
-Z(CODE)SWILIB_FUNC19C=A0074670-A0074673
-Z(CODE)SWILIB_FUNC1B8_1BB=A00746E0-A00746EF
-Z(CODE)SWILIB_FUNC1E9=A00747A4-A00747A7
-Z(CODE)SWILIB_FUNC2EE=A0074BB8-A0074BFF
// </config>

//A0074000

-Z(CODE)PATCH_ONCREATE=A0432AB8-A0432ABB
-Z(CODE)PATCH_ONCLOSE=A0432ACC-A0432ACF
-Z(CODE)PATCH_ESI1=A0908CFC-A0908CFF
-Z(CODE)PATCH_ESI2=A0908D0C-A0908D0F
-Z(CODE)PATCH_SHOWMSG_BLF=A066124C-A066124F
-Z(CODE)PATCH_NO_BROWSE_TXT=A0552E62-A0552E67

-Z(CODE)PATCH_EXT2_R4R7=A04D9F8A-A04D9F8F    // +
-Z(CODE)PATCH_EXT2_R6R5=A04DA0A4-A04DA0A7     // +
-Z(CODE)PATCH_EXT2_R5R1=A04D9DF2-A04D9DF5     // +
-Z(CODE)PATCH_EXT2_R5R7=A04D9CF4-A04D9CF7    // +
-Z(CODE)PATCH_EXT2_CLUST1=A04D9FB6-A04D9FB7   // +
-Z(CODE)PATCH_EXT2_CLUST2=A04D9D14-A04D9D15   // +
-Z(CODE)PATCH_EXT2_JUMPERS=A04D3E28-A04D3E4F  // +
-Z(CODE)PATCH_EXT2_IMPL=A04D9FD4-A04D9FE9    //+


-Z(CODE)PATCH_ENABLE_ALTOPEN=A05A35A2-A05A35A3

-Z(CODE)PATCH_GET_PIT=A0978B88-A0978B8B      // +
-Z(CODE)PATCH_GET_PITJ=A0978B8C-A0978B8F      // +

-Z(CODE)FSWI_PATCH1=A13A3694-A13A3697
-Z(CODE)FSWI_PATCH2=A13A35A8-A13A35AB
