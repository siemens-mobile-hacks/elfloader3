-carm
-Z(CODE)START,CODE,SWITAB,INITTAB,DATA_ID,DATA_C,CONFIG_DATA_ID=A0FD8000-A0FDA000

// <config>

// </config>

-Z(DATA)CONFIG_DATA_I,DATA_N=A84C8194-FFFFFFFF

-Z(CODE)PATCH_ONCREATE=A04A3314-FFFFFFFF
-Z(CODE)PATCH_ONCLOSE=A04A3318-FFFFFFFF
-Z(CODE)PATCH_ESI=A0A81EA0-FFFFFFFF

-Z(CODE)PATCH_NO_UNK_EXT=A02A089C-A02A089F

-Z(DATA)REGEXPL_CNT=A84C8190-FFFFFFFF
-Z(CODE)REG_FILE=A02A0E94-FFFFFFFF

-Z(CODE)PATCH_GET_EXT=A02A086C-FFFFFFFF
-Z(CODE)PATCH_GET_REGEXT1=A02A067C-FFFFFFFF
-Z(CODE)PATCH_GET_REGEXT2=A02A0690-FFFFFFFF
-Z(CODE)PATCH_BIG_ICON=A03545DC-FFFFFFFF
-Z(CODE)PATCH_REGEXPL=A02A0F7C-FFFFFFFF

-Z(CODE)PATCH_GET_PIT=A07FF29C-FFFFFFFF
-Z(CODE)PATCH_GET_PITJ=A07FF2A0-FFFFFFFF

-Z(CODE)PATCH_KEYB_MSG=A07F41F4-FFFFFFFF
-Z(CODE)PATCH_KEYB_MSGJ=A07F41F8-FFFFFFFF

-Z(CODE)FSWI_PATCH1=A0092BE4-FFFFFFFF
-Z(CODE)FSWI_PATCH2=A0092CC8-FFFFFFFF
-Z(CODE)FSWI_PATCH3=A0092CC7-FFFFFFFF
