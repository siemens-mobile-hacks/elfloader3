//(p) Hotter
-carm
-Z(CODE)START,CODE,SWITAB,INITTAB,DATA_ID,DATA_C,CONFIG_DATA_ID=A0078000-A007D000     //+

// <config>
// Autogenerated with tools/src/porting.ts

// 20k unused memory block
-Z(DATA)DATA_Z,DATA_I,DATA_N=A8E90200-A8E95200

// BL to any void-function in low level OS initialization (after ExtRAM init)
-Z(CODE)PATCH_LL_INIT_HOOK=A01FB444-A01FB447

// Fix IDLE CSM restart on SIM error
-Z(CODE)PATCH_NO_IDLE_RESTART=A02660B8-A02660CF

// Fix race condition in BSD sockets
-Z(CODE)PATCH_SOCKET_FUNC_SOCKET=A0B47314-A0B47333
-Z(CODE)PATCH_SOCKET_FUNC_BIND=A0B47630-A0B4764F
-Z(CODE)PATCH_SOCKET_FUNC_CONNECT=A0B47838-A0B47857
-Z(CODE)PATCH_SOCKET_FUNC_SHUTDOWN=A0B479D2-A0B479F1
-Z(CODE)PATCH_SOCKET_FUNC_RECV=A0B47BF8-A0B47C17
-Z(CODE)PATCH_SOCKET_FUNC_RECV2=A0B47C84-A0B47CA3
-Z(CODE)PATCH_SOCKET_FUNC_SENDTO=A0B483F8-A0B48417
-Z(CODE)PATCH_SOCKET_FUNC_LISTEN=A0B48572-A0B48591
-Z(CODE)PATCH_SOCKET_FUNC_RECVFROM=A0B47E3E-A0B47E5D
-Z(CODE)PATCH_SOCKET_FUNC_RECVFROM2=A0B47ED6-A0B47EF5
-Z(CODE)PATCH_SOCKET_FUNC_SEND=A0B480EE-A0B4810D
-Z(CODE)PATCH_SOCKET_FUNC_SEND2=A0B481B6-A0B481D5
-Z(CODE)PATCH_SOCKET_FUNC_GETHOSTBYNAME=A0B48AE4-A0B48B03

// SWILIB
-Z(CODE)LIBR=A0074000-A0077FFF
-Z(CODE)SWILIB_FUNC00B=A007402C-A007402F
-Z(CODE)SWILIB_FUNC00C=A0074030-A0074033
-Z(CODE)SWILIB_FUNC095=A0074254-A0074257
-Z(CODE)SWILIB_FUNC12B_12D=A00744AC-A00744B7
-Z(CODE)SWILIB_FUNC171=A00745C4-A00745C7
-Z(CODE)SWILIB_FUNC172=A00745C8-A00745CB
-Z(CODE)SWILIB_FUNC19C=A0074670-A0074673
-Z(CODE)SWILIB_FUNC1B8_1BB=A00746E0-A00746EF
-Z(CODE)SWILIB_FUNC1E9=A00747A4-A00747A7
-Z(CODE)SWILIB_FUNC2EE=A0074BB8-A0074BFF
// </config>

-Z(CODE)PATCH_ONCREATE=A03F79A4-A03F79A7      //+???
-Z(CODE)PATCH_ONCLOSE=A03F79B8-A03F79BB       //+???
-Z(CODE)PATCH_ESI1=A07A9C1C-A07A9C1F          //+???
-Z(CODE)PATCH_ESI2=A07A9C2C-A07A9C2F          //+???
-Z(CODE)PATCH_SHOWMSG_BLF=A0519074-A0519077   //+???
-Z(CODE)PATCH_NO_BROWSE_TXT=A04652EA-A04652ED //+???  //or // A04652EA-A04652EB

-Z(CODE)PATCH_EXT2_R4R7=A026F2FA-A026F2FD     //+???
-Z(CODE)PATCH_EXT2_R6R5=A026F414-A026F417     //+???
-Z(CODE)PATCH_EXT2_R5R1=A026F162-A026F165     //+???
-Z(CODE)PATCH_EXT2_R5R7=A026F064-A026F067     //+???
-Z(CODE)PATCH_EXT2_CLUST1=A026F326-A026F327   //+???
-Z(CODE)PATCH_EXT2_CLUST2=A026F084-A026F085   //+???
-Z(CODE)PATCH_EXT2_JUMPERS=A01C0EB4-A01C0EDB  //+???
-Z(CODE)PATCH_EXT2_IMPL=A026F344-A026F359     //+???

-Z(CODE)PATCH_ENABLE_ALTOPEN=A033DB6E-A033DB6F  //+???

-Z(CODE)PATCH_GET_PIT=A07FBBFC-A07FBBFF         //+???
-Z(CODE)PATCH_GET_PITJ=A07FBC00-A07FBC03        //+???

-Z(CODE)FSWI_PATCH1=A1079DB4-A1079DB7           //+???
-Z(CODE)FSWI_PATCH2=A1079CC8-A1079CCB           //+???
