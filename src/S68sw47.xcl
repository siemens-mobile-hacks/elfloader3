-carm
-Z(CODE)START,CODE,SWITAB,INITTAB,DATA_ID,DATA_C,CONFIG_DATA_ID=A0078000-A007D000

// <config>
// Autogenerated with tools/src/porting.ts

// 20k unused memory block
-Z(DATA)DATA_Z,DATA_I,DATA_N=A8E90200-A8E95200

// BL to any void-function in low level OS initialization (after ExtRAM init)
-Z(CODE)PATCH_LL_INIT_HOOK=A01FB1E0-A01FB1E3

// Fix IDLE CSM restart on SIM error
-Z(CODE)PATCH_NO_IDLE_RESTART=A0265E10-A0265E27

// Fix race condition in BSD sockets
-Z(CODE)PATCH_SOCKET_FUNC_SOCKET=A0B469A0-A0B469BF
-Z(CODE)PATCH_SOCKET_FUNC_BIND=A0B46CBC-A0B46CDB
-Z(CODE)PATCH_SOCKET_FUNC_CONNECT=A0B46EC4-A0B46EE3
-Z(CODE)PATCH_SOCKET_FUNC_SHUTDOWN=A0B4705E-A0B4707D
-Z(CODE)PATCH_SOCKET_FUNC_RECV=A0B47284-A0B472A3
-Z(CODE)PATCH_SOCKET_FUNC_RECV2=A0B47310-A0B4732F
-Z(CODE)PATCH_SOCKET_FUNC_SENDTO=A0B47A84-A0B47AA3
-Z(CODE)PATCH_SOCKET_FUNC_LISTEN=A0B47BFE-A0B47C1D
-Z(CODE)PATCH_SOCKET_FUNC_RECVFROM=A0B474CA-A0B474E9
-Z(CODE)PATCH_SOCKET_FUNC_RECVFROM2=A0B47562-A0B47581
-Z(CODE)PATCH_SOCKET_FUNC_SEND=A0B4777A-A0B47799
-Z(CODE)PATCH_SOCKET_FUNC_SEND2=A0B47842-A0B47861
-Z(CODE)PATCH_SOCKET_FUNC_GETHOSTBYNAME=A0B48170-A0B4818F

// SWILIB
-Z(CODE)LIBR=A0074000-A0077FFF
-Z(CODE)SWILIB_FUNC00B=A007402C-A007402F
-Z(CODE)SWILIB_FUNC00C=A0074030-A0074033
-Z(CODE)SWILIB_FUNC095=A0074254-A0074257
-Z(CODE)SWILIB_FUNC12B_12D=A00744AC-A00744B7
-Z(CODE)SWILIB_FUNC171=A00745C4-A00745C7
-Z(CODE)SWILIB_FUNC172=A00745C8-A00745CB
-Z(CODE)SWILIB_FUNC19C=A0074670-A0074673
-Z(CODE)SWILIB_FUNC1B8_1BB=A00746E0-A00746EF
-Z(CODE)SWILIB_FUNC1E9=A00747A4-A00747A7
-Z(CODE)SWILIB_FUNC2EE=A0074BB8-A0074BFF
// </config>

//A0074000
-Z(CODE)PATCH_ONCREATE=A03F75CC-A03F75CF
-Z(CODE)PATCH_ONCLOSE=A03F75E0-A03F75E3
-Z(CODE)PATCH_ESI1=A07A93E0-A07A93E3
-Z(CODE)PATCH_ESI2=A07A93F0-A07A93F3
-Z(CODE)PATCH_SHOWMSG_BLF=A0518810-A0518813
-Z(CODE)PATCH_NO_BROWSE_TXT=A0464E76-A0464E77

-Z(CODE)PATCH_EXT2_R4R7=A026EFC6-A026EFC9
-Z(CODE)PATCH_EXT2_R6R5=A026F0E0-A026F0E3
-Z(CODE)PATCH_EXT2_R5R1=A026EE2E-A026EE31
-Z(CODE)PATCH_EXT2_R5R7=A026ED30-A026ED33
-Z(CODE)PATCH_EXT2_CLUST1=A026EFF2-A026EFF3
-Z(CODE)PATCH_EXT2_CLUST2=A026ED50-A026ED51
-Z(CODE)PATCH_EXT2_JUMPERS=A01C0CD8-A01C0CFF
-Z(CODE)PATCH_EXT2_IMPL=A026F010-A026F025

-Z(CODE)PATCH_ENABLE_ALTOPEN=A033D3BE-A033D3BF

-Z(CODE)PATCH_GET_PIT=A07FB3C0-A07FB3C3
-Z(CODE)PATCH_GET_PITJ=A07FB3C4-A07FB3C7

-Z(CODE)FSWI_PATCH1=A10794A4-A10794A7
-Z(CODE)FSWI_PATCH2=A10793B8-A10793BB
